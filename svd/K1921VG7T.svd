# K1921VG7T register map
Vendor: NIIET; Series: K1921VKx; File version: 1.0
IOT control MCU (core RISC-V SCR4)
CPU: CM4 r0p1, Endian.LITTLE endian, MPU, FPU
Registers are 32-bit, read-write, reset 0x0 unless marked. A register's access mark holds for its fields unless they carry their own. Offsets are from the block's base; lines under a group give offsets from that group; [hi:lo] are bit positions; {n}, {i} and the like mark numbered series; 'fields as' and 'values as' point back to an identical list; <NAME> marks a mode.

## Memory map
0x40000000 GPIOA size 0xC00 — GPIO control registers
0x40001000 GPIOB size 0xC00
0x40010000 CAN size 0x400 — CAN control registers
0x40011000 CANMSG size 0x800 — CAN message registers
0x40020000 ADC size 0x6A4 — ADC control registers
0x50000000 DMA size 0x1024 — DMA control registers
0x50002000 FLASH size 0x1A0 — Flash status and control module
0x50003000 SIU size 0x74 — System interconnect unit
0x50004000 RCU size 0x9C — Reset and clock unit
0x50005000 RTC size 0x60 — RTC control registers
0x50006000 WDT size 0x320 — Watchdog timer
0x50007000 TMR32_0 size 0x118 — Timer 32-bit with PWM control registers
0x50008000 TMR32_1 size 0x118
0x50009000 TMR16_0 size 0x118 — Timer 16-bit with PWM control registers
0x5000A000 TMR16_1 size 0x118
0x5000B000 TMR16_2 size 0x118
0x5000C000 I2C0 size 0x48 — I2C control registers
0x5000D000 I2C1 size 0x48
0x5000E000 UART0 size 0x4C — UART control registers
0x5000F000 UART1 size 0x4C
0x50010000 SPI0 size 0x28 — SPI control registers
0x50011000 SPI1 size 0x28
0x50012000 SPI2 size 0x28
0x50013000 DAC size 0x34 — DAC control registers

## Interrupts
1 WDT — Watchdog timer interrupt
2 RTC — RTC interrupt [any cause]
3 TMR32_0 — 32-bit timer 0 interrupt
4 TMR32_1 — 32-bit timer 1 interrupt
5 TMR16_0 — 16-bit timer 0 interrupt
6 TMR16_1 — 16-bit timer 1 interrupt
7 TMR16_2 — 16-bit timer 2 interrupt
{n+8} CAN{n} (CAN) (n=0..15) — CAN{n} interrupt
24 I2C0 — I2C0 interrupt
25 I2C1 — I2C1 interrupt
26 SPI0 — SPI0 interrupt [any cause]
27 SPI0_RO (SPI0) — SPI0 Receive Overrun interrupt
28 SPI0_RT (SPI0) — SPI0 Receive Timeout interrupt
29 SPI0_RX (SPI0) — SPI0 Receive interrupt
30 SPI0_TX (SPI0) — SPI0 Transmit interrupt
31 SPI1 — SPI1 interrupt [any cause]
32 SPI1_RO (SPI1) — SPI1 Receive Overrun interrupt
33 SPI1_RT (SPI1) — SPI1 Receive Timeout interrupt
34 SPI1_RX (SPI1) — SPI1 Receive interrupt
35 SPI1_TX (SPI1) — SPI1 Transmit interrupt
36 SPI2 — SPI2 interrupt [any cause]
37 SPI2_RO (SPI2) — SPI2 Receive Overrun interrupt
38 SPI2_RT (SPI2) — SPI2 Receive Timeout interrupt
39 SPI2_RX (SPI2) — SPI2 Receive interrupt
40 SPI2_TX (SPI2) — SPI2 Transmit interrupt
41 UART0 — UART0 interrupt [any cause]
42 UART0_E (UART0) — UART0 Error interrupt
43 UART0_RT (UART0) — UART0 Receive Timeout interrupt
44 UART0_RX (UART0) — UART0 Receive interrupt
45 UART0_TD (UART0) — UART0 Transmit Done interrupt
46 UART0_TX (UART0) — UART0 Transmit interrupt
47 UART1 — UART1 interrupt [any cause]
48 UART1_E (UART1) — UART1 Error interrupt
49 UART1_RT (UART1) — UART1 Receive Timeout interrupt
50 UART1_RX (UART1) — UART1 Receive interrupt
51 UART1_TD (UART1) — UART1 Transmit Done interrupt
52 UART1_TX (UART1) — UART1 Transmit interrupt
53 ADC_DC (ADC) — ADC Digital Comparators interrupt [any source]
{n+54} ADC_DC{n} (ADC) (n=0..7) — ADC Digital Comparator {n} interrupt
62 GPIOA — GPIO A interrupt [any source]
63 GPIOB — GPIO B interrupt [any source]
{n+64} GPIO{n} (GPIOA) (n=0..15) — GPIO A pin {n} interrupt
{n+64} GPIO{n} (GPIOB) (n=16..30) — GPIO B pin {n-16} interrupt
95 ADC_SEQ (ADC) — ADC Sequencers interrupt [any source]
{n+96} DMA_CH{n} (DMA) (n=0..7) — DMA channel {n} interrupt
104 ADC_SEQ0 (ADC) — ADC Sequencer 0 interrupt
105 ADC_SEQ1 (ADC) — ADC Sequencer 1 interrupt
106 ADC_SEQ2 (ADC) — ADC Sequencer 2 interrupt
107 ADC_SEQ3 (ADC) — ADC Sequencer 3 interrupt
108 FLASH — Flash interrupt
109 RCU — RCU interrupt
110 RTC_ALARM1 (RTC) — RTC alarm 1 interrupt
111 RTC_ALARM2 (RTC) — RTC alarm 2 interrupt
112 RTC_BATTERY (RTC) — RTC switch to battery power supply interrupt
113 RTC_N_POWER (RTC) — RTC switch to normal power supply interrupt
114 RTC_OVERFLOW (RTC) — RTC timer overflow interrupt
115 TMR32_0_P (TMR32_0) — 32-bit timer 0 period interrupt
116 TMR32_1_P (TMR32_1) — 32-bit timer 1 period interrupt
117 TMR16_0_P (TMR16_0) — 16-bit timer 0 period interrupt
118 TMR16_1_P (TMR16_1) — 16-bit timer 1 period interrupt
119 TMR16_2_P (TMR16_2) — 16-bit timer 2 period interrupt
120 TMR32_0_CC (TMR32_0) — 32-bit timer 0 capture/compare interrupt
121 TMR32_1_CC (TMR32_1) — 32-bit timer 1 capture/compare interrupt
122 TMR16_0_CC (TMR16_0) — 16-bit timer 0 capture/compare interrupt
123 TMR16_1_CC (TMR16_1) — 16-bit timer 1 capture/compare interrupt
124 TMR16_2_CC (TMR16_2) — 16-bit timer 2 capture/compare interrupt

## Licence text in the file
THIS SOFTWARE IS PROVIDED "AS IS". NO WARRANTIES, WHETHER EXPRESS, IMPLIED OR STATUTORY, INCLUDING, BUT NOT LIMITED TO, IMPLIED WARRANTIES OF MERCHANTABILITY AND FITNESS FOR A PARTICULAR PURPOSE APPLY TO THIS SOFTWARE. ARM SHALL NOT, IN ANY CIRCUMSTANCES, BE LIABLE FOR SPECIAL, INCIDENTAL, OR CONSEQUENTIAL DAMAGES, FOR ANY REASON WHATSOEVER.
